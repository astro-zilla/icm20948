## drivers/sensor/icm20948/Kconfig
```kconfig
config ICM20948
    bool "ICM20948 9-axis Motion Sensor"
    depends on DT_HAS_INVENSENSE_ICM20948_ENABLED
    select I2C
    help
      Enable support for the ICM20948 9-axis Motion Sensor

      https://www.invensense.com/products/motion-tracking/9-axis/icm-20948/
        Requires I2C or SPI.

if ICM20948

  config ICM20948_INIT_PRIORITY
    int "Init priority"
    default SENSOR_INIT_PRIORITY
    help
      Set the initialization priority of the ICM20948 driver.
      Higher numbers indicate higher priority.

  config ICM20948_THREAD_PRIORITY
    int "Thread priority"
    default 10
    help
      Set the thread priority for the ICM20948 trigger thread.
      Higher numbers indicate lower priority.

  config ICM20948_THREAD_STACK_SIZE
    int "Thread stack size"
    depends on ICM20948_TRIGGER_OWN_THREAD
    default 1024
    help
      Stack size of thread used by the driver to handle interrupts.

  config ICM20948_AK09916
    bool "AK09916 Magnetometer Support"
    default y
    depends on ICM20948
    depends on DT_HAS_ASAHI_KASEI_AK09916_ENABLED
    help
      Enable support for the AK09916 magnetometer integrated in the ICM20948 sensor.

  choice
    prompt "Trigger mode"
    default ICM20948_TRIGGER_NONE
    help
      Specify the type of triggering used by the driver.

    config ICM20948_TRIGGER_NONE
      bool "No trigger"

    config ICM20948_TRIGGER_GLOBAL_THREAD
      bool "Use global thread"
      depends on GPIO
      depends on $(dt_compat_any_has_prop,$(DT_COMPAT_INVENSENSE_ICM20948),int-gpios)
      select ICM20948_TRIGGER

    config ICM20948_TRIGGER_OWN_THREAD
      bool "Use own thread"
      depends on GPIO
      depends on $(dt_compat_any_has_prop,$(DT_COMPAT_INVENSENSE_ICM20948),int-gpios)
      select ICM20948_TRIGGER

  endchoice

  config ICM20948_TRIGGER
    bool "Support for triggers"
    default y
    help
      Enable support for triggers in the ICM20948 driver.

endif # ICM20948
```

## dts/bindings/sensor/asahi-kasei,ak09916.yaml
```yaml
description: AK09916 3-axis electronic compass

compatible: "asahi-kasei,ak09916"

include: [sensor-device.yaml, i2c-device.yaml]

properties:
  mode:
    type: string
    description: |
      Operating mode of the AK09916 magnetometer.
    enum:
      - "powerdown"
      - "singlemeasure"
      - "cont_10hz"
      - "cont_20hz"
      - "cont_50hz"
      - "cont_100hz"
      - "selftest"
```

## dts/bindings/sensor/invensense,icm20948.yaml
```yaml
description: "InvenSense ICM-20948 9-axis motion tracking device"

compatible: "invensense,icm20948"

include: [sensor-device.yaml, i2c-device.yaml]

properties:
  irq-gpios:
    type: phandle-array
    description: |
      The INT signal default configuration is active-high.  The
      property value should ensure the flags properly describe the
      signal that is presented to the driver.
      This property is required when the trigger mode is used.

  gyro-sr-div:
    type: int
    required: true
    description: |
      Default gyrscope sample rate divider. This divider is only effective
      when gyro-dlpf is in range 1-6 and gyro-fchoice is 1.
      rate = sample_rate / (1 + gyro-smplrt-div)
      Valid range: 0 - 255

  gyro-dlpf:
    type: string
    required: true
    description: |
      Default digital low pass filter frequency of gyroscope.
      Maps to GYRO_DLPFCFG field in Gyroscope Configuration setting.
    enum:
      - "196.6"
      - "151.8"
      - "119.5"
      - "51.2"
      - "23.9"
      - "11.6"
      - "5.7"
      - "361.4"
  
  gyro-fs-sel:
    type: int
    required: true
    description: |
      Default full scale of gyroscope. (Unit - DPS).
      Maps to GYRO_FS_SEL field in Gyroscope Configuration setting.
    enum:
      - 250
      - 500
      - 1000
      - 2000

  gyro-fchoice:
    type: boolean
    description: |
      Enable/Disable gyroscope digital low pass filter.
      Maps to GYRO_FCHOICE field in Gyroscope Configuration setting.

  accel-sr-div:
    type: int
    required: true
    description: |
      Default accelerometer sample rate divider. This divider is only effective
      when accel-dlpf is in range 1-6 and accel-fchoice is 1.
      rate = 1.125 kHz/(1+ACCEL_SMPLRT_DIV[11:0])
      Valid range: 0 - 4095

  accel-dlpf:
    type: string
    required: true
    description: |
      Default digital low pass filter frequency of accelerometer.
      Maps to ACCEL_DLPFCFG field in Accelerometer Configuration setting.
    enum:
      - "246.0"
      - "246.0a"
      - "111.4"
      - "50.4"
      - "23.9"
      - "11.5"
      - "5.7"
      - "473"

  accel-fs-sel:
    type: int
    required: true
    description: |
      Default full scale of accelerometer. (Unit - g)
      Maps to ACCEL_FS_SEL field in Accelerometer Configuration setting
    enum:
      - 2
      - 4
      - 8
      - 16

  accel-fchoice:
    type: boolean
    description: |
      Enable/Disable accelerometer digital low pass filter.
      Maps to ACCEL_FCHOICE field in Accelerometer Configuration setting.

  mag-sr-div:
    type: int
    required: true
    description: |
      Default magnetometer sample rate divider.
      rate = 100Hz / (1 + mag-smplrt-div)
      Valid range: 0 - 255

  fifo-enable:
    type: boolean
    description: |
      Enable/Disable FIFO buffer.
```
